## main/Kconfig.projbuild
```kconfig
menu "ToF Height Estimation"

    choice APP_MODE
        prompt "Application run mode"
        default APP_MODE_SST_CSV

        config APP_MODE_SST_CSV
            bool "Single-sensor: 8x8 distance logger"
        config APP_MODE_SST_REPEAT
            bool "Single-sensor: repeatability"
        config APP_MODE_SST_SPECULAR
            bool "Single-sensor: specular response"
        config APP_MODE_SST_WATER
            bool "Single-sensor: water level"
        config APP_MODE_HEIGHT_DEMO
            bool "Height demo (1000 mm placeholder baseline)"
    endchoice

    config APP_REPEAT_FRAME_COUNT
        int "Repeatability frame count"
        range 2 10000
        default 100

    config APP_WATER_INSTALL_HEIGHT_MM
        int "Sensor installation height (mm)"
        range 1 10000
        default 1000

    config APP_OUTPUT_INTERVAL_MS
        int "Serial output interval (ms)"
        range 100 60000
        default 5000

    comment "Low-power sender defaults (the UI overrides these at runtime)"

    config APP_DEFAULT_SLEEP_S
        int "Default sleep seconds (0 disables sleep)"
        range 0 3600
        default 25
        help
            Boot value until A pushes a CONFIG_SET. Demo profile 1 is 25 s and
            profile 2 is 10 s. Set 0 to keep the node awake continuously, which
            is useful when debugging over USB.

    config APP_DEFAULT_WAKE_S
        int "Default wake window seconds"
        range 1 3600
        default 10
        help
            Total active window of one cycle, not an extra wait added after the
            measurement.

    config APP_DEFAULT_MEASURE_COUNT
        int "Measurements per wake window"
        range 1 10
        default 1

    config APP_MEASURE_ATTEMPTS
        int "Attempts per measurement before giving up"
        range 1 10
        default 3

endmenu
```

## sdkconfig.defaults
```kconfig
CONFIG_IDF_TARGET="esp32s3"
CONFIG_ESP_MAIN_TASK_STACK_SIZE=8192
CONFIG_ESP_CONSOLE_UART_DEFAULT=y
CONFIG_ESP_CONSOLE_SECONDARY_USB_SERIAL_JTAG=y

# Heltec WiFi LoRa 32 V3 onboard SX1262 (SPI2)
CONFIG_MISO_GPIO=11
CONFIG_MOSI_GPIO=10
CONFIG_SCLK_GPIO=9
CONFIG_NSS_GPIO=8
CONFIG_RST_GPIO=12
CONFIG_BUSY_GPIO=13
CONFIG_TXEN_GPIO=-1
CONFIG_RXEN_GPIO=-1
CONFIG_SPI2_HOST=y
CONFIG_USE_TCXO=y
```
